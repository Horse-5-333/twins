## config/boards/shields/twins/Kconfig.defconfig
```kconfig
if SHIELD_TWINS_LEFT

config ZMK_KEYBOARD_NAME
    default "Twins"

config ZMK_SPLIT_ROLE_CENTRAL
    default y

config USB
    default y

config ZMK_USB
    default y

config ZMK_USB_BOOT
    default y

endif

if SHIELD_TWINS_LEFT || SHIELD_TWINS_RIGHT

config ZMK_SPLIT
    default y

endif
```

## config/boards/shields/twins/Kconfig.shield
```kconfig
# Copyright (c) 2020 Pete Johanson
# SPDX-License-Identifier: MIT

config SHIELD_TWINS_LEFT
    def_bool $(shields_list_contains,twins_left)

config SHIELD_TWINS_RIGHT
    def_bool $(shields_list_contains,twins_right)
```

## config/boards/shields/twins_view_adapter/Kconfig.shield
```kconfig
# Copyright (c) 2022 The ZMK Contributors
# SPDX-License-Identifier: MIT

config SHIELD_NICE_VIEW_ADAPTER
    def_bool $(shields_list_contains,twins_view_adapter)
```
